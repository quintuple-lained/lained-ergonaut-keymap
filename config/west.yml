## config/west.yml
```yaml
manifest:
  remotes:
    - name: zmkfirmware
      url-base: https://github.com/zmkfirmware
    - name: quintuple-lained
      url-base: https://github.com/quintuple-lained
  projects:
    - name: zmk
      remote: zmkfirmware
      revision: main
      import: app/west.yml
    - name: ergonautkb-zmk-module
      remote: quintuple-lained
      revision: main
  self:
    path: config
```

## ergonautkb-zmk-module/boards/shields/ergonaut_one_dongle/Kconfig.defconfig
```kconfig
if SHIELD_ERGONAUT_ONE_DONGLE

config ZMK_KEYBOARD_NAME
    default "Ergonaut Dongle"

config ZMK_SPLIT_ROLE_CENTRAL
    default y

endif
```

## ergonautkb-zmk-module/boards/shields/ergonaut_one_dongle/Kconfig.shield
```kconfig
config SHIELD_ERGONAUT_ONE_DONGLE
    def_bool $(shields_list_contains,ergonaut_one_dongle)
```
